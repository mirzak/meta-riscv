## conf/machine/sifive-unleashed.conf
```bitbake
#@TYPE: Machine
#@NAME: sfive-unleashed
#@SOC: Freedom U540
#@DESCRIPTION: Machine configuration for the SiFive Unleashed board

require conf/machine/tune-riscv.inc

MACHINE_FEATURES = "screen keyboard ext2 ext3 serial"
MACHINE_ARCH = "riscv64"

KERNEL_IMAGETYPE = "vmlinux"
KERNEL_IMAGE_STRIP_EXTRA_SECTIONS  = ".comment"

PREFERRED_PROVIDER_virtual/kernel = "linux-riscv"
PREFERRED_VERSION_qemu = "${QEMUVERSION}"
PREFERRED_VERSION_qemu-native = "${QEMUVERSION}"
PREFERRED_VERSION_nativesdk-qemu = "${QEMUVERSION}"

GDBVERSION = "riscv"
QEMUVERSION = "riscv"

EXTRA_IMAGEDEPENDS += "riscv-pk"

SERIAL_CONSOLE = "115200 ttyS0"
USE_VT ?= "0"

MACHINE_EXTRA_RRECOMMENDS += " kernel-modules"

# Prelink does not yet work

USER_CLASSES_remove = "image-prelink"

RISCV_BBL_PAYLOAD ?= "${KERNEL_IMAGETYPE}${KERNEL_INITRAMFS}-${MACHINE}.bin"

INITRAMFS_IMAGE_BUNDLE = "1"
INITRAMFS_IMAGE = "riscv-initramfs-image"
KERNEL_INITRAMFS = '-initramfs'
```

## wic/sifive-unleashed-bbl.wks
```
# short-description: Create SD card image with a boot partition
# long-description:
# Create an image that can be written onto a SD card using dd for use
# with SiFive Unleashed board.
#
# It uses bbl as bootloader
#
# The disk layout used is:
#  - --------- --------------
# | | bbl     |    rootfs   |
#  - --------- --------------
# ^ ^         ^
# | |         |
# 0 1kiB      4MiB + rootfs + IMAGE_EXTRA_SPACE (default 10MiB)

part /boot --source bootimg-partition --ondisk mmcblk --fstype=vfat --label boot --active --align 1 --use-uuid --fsuuid 2e54b353-1271-4842-806f-e436d6af6985
part / --source rootfs --ondisk mmcblk --fstype=ext4 --label root --align 4096 --size 1G

bootloader --ptable msdos
```
